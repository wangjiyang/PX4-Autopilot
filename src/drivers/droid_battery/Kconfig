## src/drivers/droid_battery/Kconfig
```kconfig
menuconfig DRIVERS_DROID_BATTERY
	bool "droid_battery"
	default n
	---help---
		Battery bridge for Android: receives phone battery readings
		from the Java BatteryManager layer over local UDP and
		publishes battery_status
```

## src/drivers/droid_gps/Kconfig
```kconfig
menuconfig DRIVERS_DROID_GPS
	bool "droid_gps"
	default n
	---help---
		GNSS bridge for Android: receives fixes from the Java
		LocationManager layer over local UDP and publishes sensor_gps
```

## src/drivers/droid_rc/Kconfig
```kconfig
menuconfig DRIVERS_DROID_RC
	bool "droid_rc"
	default n
	---help---
		Synthetic centered-stick pilot input for the phone demo
		(no RC receiver on a phone)
```

## src/drivers/droid_sensors/Kconfig
```kconfig
menuconfig DRIVERS_DROID_SENSORS
	bool "droid_sensors"
	default n
	---help---
		Android sensor bridge: publishes the phone's IMU/mag/baro
		(via the NDK ASensorManager API) as PX4 uORB sensor topics
```

## src/drivers/droid_status/Kconfig
```kconfig
menuconfig DRIVERS_DROID_STATUS
	bool "droid_status"
	default n
	---help---
		Streams FC status to the hosting Android app's debug UI
		over local UDP (127.0.0.1:14560)
```
